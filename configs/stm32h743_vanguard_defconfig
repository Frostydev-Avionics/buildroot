## configs/stm32h743_vanguard_defconfig
```kconfig
BR2_arm=y
BR2_cortex_m7=y
BR2_ARM_INSTRUCTIONS_THUMB2=y
BR2_ARM_FPU_VFPV5_D16=y

BR2_TOOLCHAIN_EXTERNAL=y
BR2_TOOLCHAIN_EXTERNAL_BOOTLIN_ARMV7M_UCLIBC_STABLE=y
BR2_GLOBAL_PATCH_DIR="board/frostydev/vanguard_v2/patches"
BR2_ROOTFS_POST_BUILD_SCRIPT="board/frostydev/vanguard_v2/post-build.sh"

# LINUX KERNEL (XIP directly from Flash)
BR2_LINUX_KERNEL=y
BR2_LINUX_KERNEL_CUSTOM_VERSION=y
BR2_LINUX_KERNEL_CUSTOM_VERSION_VALUE="6.1.28"
BR2_LINUX_KERNEL_DEFCONFIG="stm32"
BR2_LINUX_KERNEL_CONFIG_FRAGMENT_FILES="board/frostydev/vanguard_v2/linux.config"
BR2_LINUX_KERNEL_DTS_SUPPORT=y
BR2_LINUX_KERNEL_USE_CUSTOM_DTS=y
BR2_LINUX_KERNEL_CUSTOM_DTS_PATH="board/frostydev/vanguard_v2/vanguard_stm32h743.dts"
BR2_LINUX_KERNEL_IMAGE_TARGET_CUSTOM=y
BR2_LINUX_KERNEL_IMAGE_TARGET_NAME="xipImage"
BR2_LINUX_KERNEL_IMAGE_NAME="xipImage"
BR2_LINUX_KERNEL_INSTALL_TARGET=y

# FILESYSTEM
BR2_TARGET_ROOTFS_INITRAMFS=y

# PACKAGES
BR2_PACKAGE_HOST_OPENOCD=y
BR2_PACKAGE_EVTEST=y
BR2_PACKAGE_VANGUARD_FC=y
BR2_PACKAGE_DROPBEAR=y
BR2_PACKAGE_GDB=y
BR2_PACKAGE_GDB_SERVER=y
```
